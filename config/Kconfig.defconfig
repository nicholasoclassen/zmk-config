## config/Kconfig.defconfig
```kconfig
if SHIELD_OAK58_LEFT

config ZMK_KEYBOARD_NAME
    default "oak58"

config ZMK_SPLIT_ROLE_CENTRAL
    default y

endif

if SHIELD_OAK58_LEFT || SHIELD_OAK58_RIGHT

config ZMK_SPLIT
    default y

endif
```

## config/boards/shields/lily58-oak/Kconfig.shield
```kconfig
# Copyright (c) 2020 Pete Johanson
# SPDX-License-Identifier: MIT

config SHIELD_LILY58-OAKL
    def_bool $(shields_list_contains,lily58-oak_left)

config SHIELD_LILY58-OAKR
    def_bool $(shields_list_contains,lily58-oak_right)
```

## config/boards/shields/lily58_oak/Kconfig.shield
```kconfig
# Copyright (c) 2020 Pete Johanson
# SPDX-License-Identifier: MIT

config SHIELD_LILY58_OAK_LEFT
    def_bool $(shields_list_contains,lily58_oak_left)

config SHIELD_LILY58_OAK_RIGHT
    def_bool $(shields_list_contains,lily58_oak_right)
```

## config/boards/shields/oak58/Kconfig.defconfig
```kconfig
if SHIELD_OAK58_LEFT

config ZMK_KEYBOARD_NAME
    default "oak58-l"

config ZMK_SPLIT_BLE_ROLE_CENTRAL
    default y

endif

if SHIELD_OAK58_LEFT || SHIELD_OAK58_RIGHT

config ZMK_SPLIT
    default y

endif
```

## config/boards/shields/oak58/Kconfig.shield
```kconfig
# Copyright (c) 2020 Pete Johanson
# SPDX-License-Identifier: MIT

config SHIELD_OAK58_LEFT
    def_bool $(shields_list_contains,oak58_left)

config SHIELD_OAK58_RIGHT
    def_bool $(shields_list_contains,oak58_right)
```

## config/boards/shields/oakboard/Kconfig.defconfig
```kconfig
if SHIELD_MY_BOARD

config ZMK_KEYBOARD_NAME
    default "oakboard"

endif
#why isnt this uploading??
```

## config/west.yml
```yaml
manifest:
  remotes:
    - name: petejohanson
      url-base: https://github.com/petejohanson/zmk/tree/feat/pointers-move-scroll
  projects:
    - name: zmk
      remote: petejohanson
      revision: feat/pointers-move-scroll
      import: app/west.yml
  self:
    path: config
```
